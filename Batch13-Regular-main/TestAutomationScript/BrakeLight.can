/*@!Encoding:1252*/
includes
{
  
}

variables
{
  
}

void MainTest ()
{
TestModuleTitle ("Verification of Brake Light Behaviour");
TestModuleDescription ("To verify the Brake Light Behaviour");
TestGroupBegin("Basic Brake Light Test", "To verify the Brake Light Behaviour");
BrakeLightTest();
//BrakeSwitch2Test();
//Testcase2();
TestGroupEnd();
}
testcase BrakeLightTest()
{
  @sysvar::Ignition = 0;
  testStep("Ignition = 0","Set Ignition to OFF");
  testWaitForTimeout(1000);
  @sysvar::Ignition = 2;
  testStep("Ignition = 2","Set Ignition to Run");
  setSignal(BCMInfo::VehicleSpeed,80);
  testWaitForTimeout(1000);
  setSignal(ICM_Info::CruiseSwitchRequest,1);
  testWaitForTimeout(250);
  setSignal(ICM_Info::CruiseSwitchRequest,7);   
  testWaitForTimeout(1000);  
  testValidateSignalMatch("Check ACC state is Standby",ACCInfo::ACCState,2); 
  testValidateTesterConfirmation("Is ACC switched to standby ?","Checking ACC state",1);
  
  
  setSignal(ICM_Info::CruiseSwitchRequest,2);
  testWaitForTimeout(250);
  setSignal(ICM_Info::CruiseSwitchRequest,7);   
  testWaitForTimeout(1000); 
  testValidateSignalMatch("Check ACC state is Active",ACCInfo::ACCState,3); 
  testValidateTesterConfirmation("Is ACC switched to Active ?","Checking ACC state",1);
     
  testStep("Forward Vehicle state = 1","Set Forward Vehicle state to ON");
  @sysvar::ForwardVehicleStatus = 1;
  testWaitForTimeout(1000);
  
  testValidateSignalMatch("Check Brake Light ON",ACCInfo::BrakeDecelRequest,1);
  testValidateTesterConfirmation("Is ACC Brake Light ON ?","Checking ACC Brake Light ON",1);
  
}
