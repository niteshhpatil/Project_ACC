/*@!Encoding:1252*/
includes
{
  
}

variables
{
  
}

void MainTest ()
{
TestModuleTitle ("Verification of Initialisation Behaviour of ACC");
TestModuleDescription ("To verify the Initialisation Behaviour of ACC");
TestGroupBegin("Initialisation Behaviour of ACC", "To verify the Initialisation Behaviour of ACC");
ACCInitialisationTest();
//BrakeSwitch2Test();
//Testcase2();
TestGroupEnd();
}
testcase ACCInitialisationTest()
{
  @sysvar::Ignition = 0;
  testStep("Ignition = 0","Set Ignition to OFF");
  testWaitForTimeout(1000);
  @sysvar::Ignition = 2;
  testStep("Ignition = 2","Set Ignition to Run");
  setSignal(BCMInfo::VehicleSpeed,80);
  testWaitForTimeout(1000);
  setSignal(ICM_Info::CruiseSwitchRequest,1);
  testWaitForTimeout(250);
  setSignal(ICM_Info::CruiseSwitchRequest,7);   
  testWaitForTimeout(1000);  
  testValidateSignalMatch("Check ACC state is Standby",ACCInfo::ACCState,2); 
  testValidateTesterConfirmation("Is ACC switched to standby ?","Checking ACC state",1);
  
  
  setSignal(ICM_Info::CruiseSwitchRequest,2);
  testWaitForTimeout(250);
  setSignal(ICM_Info::CruiseSwitchRequest,7);   
  testWaitForTimeout(1000); 
  testValidateSignalMatch("Check ACC state is Active",ACCInfo::ACCState,3); 
  testValidateTesterConfirmation("Is ACC switched to Active ?","Checking ACC state",1);
     
  @sysvar::Ignition = 0;
  testStep("Ignition = 0","Set Ignition to OFF");
  testWaitForTimeout(1000);
  testValidateSignalMatch("Check ACC state to OFF",ACCInfo::ACCState,0);
  
  @sysvar::Ignition = 2;
  testStep("Ignition = 0","Set Ignition to OFF");
  testWaitForTimeout(1000);
  
  testValidateSignalMatch("Check ACC state to OFF",ACCInfo::ACCState,0);  
  testValidateTesterConfirmation("Is ACC OFF state ?","Checking ACC OFF state",1);
}

