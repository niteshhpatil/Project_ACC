 /*@!Encoding:1252*/
includes
{
  
}

variables
{
  int a=10;
  int b=25; 
}


on start
{
  write("Value of =%d",a);
}


void add()
{
  int c=0;
  c=a+b;
  write("ValueAssignmentEvents of c = %d",c);
}

on key 's'
{
  add();
}

