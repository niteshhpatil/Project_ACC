/*@!Encoding:1252*/
includes
{
  
}

variables
{
  
}

on message *
{
  
  if(this.id >0x200)
  {
    output(this);
  }
  
  
}

